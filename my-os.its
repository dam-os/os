## my-os.its
```
/dts-v1/;

/ {
    description = "U-Boot FIT Image with Custom OS Kernel";
    #address-cells = <1>;

    images {
        kernel {
            description = "Custom OS Kernel";
            data = /incbin/("build/kernel.bin");
            type = "kernel";
            arch = "riscv";  // Change this to your architecture: arm, x86, etc.
            os = "custom";    // Or use "linux" if applicable
            compression = "none";
            load = <0x82200000>;  // Change this to the correct load address
            entry = <0x82200000>; // Change this to the kernel entry point
        };
    };

    configurations {
        default = "config1";

        config1 {
            description = "Boot Configuration";
            kernel = "kernel";
            fdt = "fdt";  // Add if using a Flattened Device Tree
        };
    };
};
```
